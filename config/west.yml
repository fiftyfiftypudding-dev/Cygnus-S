## config/west.yml
```yaml
manifest:
  remotes:
  - name: zmkfirmware
    url-base: https://github.com/zmkfirmware
  - name: sayu-hub # pmw3610-driver のフォーク
    url-base: https://github.com/sayu-hub
  - name: Dist16384 # あなたのフォーク
    url-base: https://github.com/Dist16384
  - name: caksoylar # <-- RGB LED
    url-base: https://github.com/caksoylar
  - name: cormoran # DYA Studio 用カスタムZMK/モジュール
    url-base: https://github.com/cormoran

  projects:
  - name: zmk
    remote: cormoran
    revision: v0.3-branch+dya
    path: zmk
    import: app/west.yml
  - name: zmk-pmw3610-driver
    remote: Dist16384
    revision: main
    path: modules/zmk-pmw3610-driver
  - name: zmk-rgbled-widget
    remote: caksoylar
    revision: v0.3
  - name: zmk-module-ble-management
    remote: cormoran
    revision: 2147ba7
  - name: zmk-module-battery-history
    remote: cormoran
    revision: main
  - name: zmk-module-settings-rpc
    remote: cormoran
    revision: main
  - name: zmk-module-runtime-input-processor
    remote: cormoran
    revision: e186007
  - name: zmk-feature-custom-settings
    remote: cormoran
    revision: 02cc69f

  self:
    path: config
```
